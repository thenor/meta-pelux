## meta-rcar-extras/conf/layer.conf
```bitbake
#
#   Copyright (C) 2018 Luxoft Sweden AB
#
# We have a conf and classes directory, append to BBPATH
BBPATH .= ":${LAYERDIR}"

# We have a recipes directory, add to BBFILES
BBFILES += "${LAYERDIR}/recipes-*/*/*.bb ${LAYERDIR}/recipes-*/*/*.bbappend"

BBFILE_COLLECTIONS += "pelux-bsp-renesas-layer"
BBFILE_PATTERN_pelux-bsp-renesas-layer := "^${LAYERDIR}/"

BBFILE_PRIORITY_pelux-bsp-renesas-layer = "10"
```
